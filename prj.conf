## CMakeLists.txt
```
#
# Copyright (c) 2020 Nordic Semiconductor
#
# SPDX-License-Identifier: LicenseRef-Nordic-5-Clause
#
cmake_minimum_required(VERSION 3.20.0)

if(DEFINED SHIELD AND "${BOARD}" STREQUAL "nrf5340dk_nrf5340_cpunet")
  string(REPLACE " " ";" SHIELD_LIST "${SHIELD}")
  foreach(sh IN LISTS SHIELD_LIST)
    if("${sh}" STREQUAL "nrf21540ek")
      if(CONFIG_DTM_USB)
        set(remote_shell_DTC_OVERLAY_FILE ${CMAKE_CURRENT_LIST_DIR}/conf/remote_shell/nrf21540ek_usb.overlay)
      else()
        set(remote_shell_DTC_OVERLAY_FILE ${CMAKE_CURRENT_LIST_DIR}/conf/remote_shell/nrf21540ek.overlay)
      endif()

      break()
    endif()
  endforeach()
endif()

if(NOT DEFINED remote_shell_DTC_OVERLAY_FILE AND CONFIG_DTM_USB)
  set(remote_shell_DTC_OVERLAY_FILE ${CMAKE_CURRENT_LIST_DIR}/conf/remote_shell/usb.overlay)
endif()

if(CONFIG_DTM_USB)
  set(remote_shell_CONF_FILE ${CMAKE_CURRENT_LIST_DIR}/conf/remote_shell/prj_usb.conf)
endif()

if("${BOARD}" STREQUAL "nrf5340dk_nrf5340_cpunet")
  if(NOT "${EXTRA_CONF_FILE}" STREQUAL "overlay-hci-nrf53.conf")
    set(EXTRA_DTC_OVERLAY_FILE "${CMAKE_CURRENT_LIST_DIR}/conf/remote_shell_nrf53.overlay")
  endif()
endif()

find_package(Zephyr REQUIRED HINTS $ENV{ZEPHYR_BASE})
project(direct_test_mode)

target_include_directories(app PRIVATE ./src)

target_sources_ifdef(CONFIG_DTM_TRANSPORT_TWOWIRE app PRIVATE
  src/transport/dtm_uart_twowire.c
  src/transport/dtm_uart_wait.c
)

target_sources_ifdef(CONFIG_DTM_TRANSPORT_HCI app PRIVATE src/transport/dtm_hci.c)

if(CONFIG_NCS_SAMPLE_DTM_REMOTE_HCI_CHILD_IMAGE)
  target_sources(app PRIVATE src/transport/hci_uart_remote.c)
  target_include_directories(app PRIVATE ./rpc)
else()
  target_sources_ifdef(CONFIG_DTM_TRANSPORT_HCI app PRIVATE src/transport/hci_uart.c)
endif()

# RTT transport

target_sources_ifdef(CONFIG_DTM_TRANSPORT_RTT app PRIVATE
  src/transport/dtm_rtt_twowire.c
)

# Shared command decoder core

target_sources(app PRIVATE src/transport/dtm_cmd_core.c)

# NORDIC SDK APP START
target_sources(app PRIVATE
  src/dtm.c
  src/dtm_hw.c
  src/main.c
  src/dtm_shell_commands.c
)
# NORDIC SDK APP END
```

## Kconfig
```
#
# Copyright (c) 2020 Nordic Semiconductor
#
# SPDX-License-Identifier: LicenseRef-Nordic-5-Clause
#

mainmenu "Nordic DTM sample"

config DTM_RADIO_IRQ_PRIORITY
	int "Radio interrupt priority"
	range 0 5 if ZERO_LATENCY_IRQS
	range 0 6
	default 2
	help
	  Sets Radio interrupt priority.
	  Levels are from 0 (highest priority) to 6 (lowest priority)

config DTM_TIMER_IRQ_PRIORITY
	int "DTM timer interrupt priority"
	range 0 5 if ZERO_LATENCY_IRQS
	range 0 6
	default 3
	help
	  Sets DTM timer interrupt priority.
	  Levels are from 0 (highest priority) to 6 (lowest priority)

config ANOMALY_172_TIMER_IRQ_PRIORITY
	int "Anomaly 172 timer interrupt priority"
	depends on SOC_NRF52840
	range 0 5 if ZERO_LATENCY_IRQS
	range 0 6
	default 2
	help
	  Sets anomaly 172 timer interrupt priority.
	  Levels are from 0 (highest priority) to 6 (lowest priority)

config DTM_USB
	bool "DTM over USB CDC ACM class"
	depends on SOC_NRF5340_CPUNET && DTM_TRANSPORT_TWOWIRE
	select EXPERIMENTAL
	help
	  Use USB instead of UART as the DTM interface. For nRF5340 the USB from application core
	  is used as communication interface.

choice DTM_TRANSPORT
	default DTM_TRANSPORT_TWOWIRE
	prompt "Transport layer to use with DTM."
	help
	  Transport interface to use with the DTM.

config DTM_TRANSPORT_TWOWIRE
	bool "DTM over Two Wire UART"
	depends on SERIAL
	help
	  Use the Two Wire transport interface as the DTM transport layer.

config DTM_TRANSPORT_HCI
	bool "DTM over HCI UART [EXPERIMENTAL]"
	depends on SERIAL
	depends on NET_BUF
	select EXPERIMENTAL
	help
	  Use the HCI UART transport interface as the DTM transport layer.

config DTM_TRANSPORT_RTT
	bool "DTM over Two Wire RTT"
	depends on USE_SEGGER_RTT
	help
	  Use SEGGER RTT channel 0 with 2-octet Two-Wire protocol as DTM transport. Enables CLI over RTT instead of UART.

endchoice # DTM_TRANSPORT

if DTM_TRANSPORT_HCI

config DTM_HCI_QUEUE_COUNT
	int "Count of HCI RX/TX queues"
	default 16
	help
	  Maximum depth of the HCI RX/TX queues.

config DTM_HCI_QUEUE_SIZE
	int "Size of HCI RX/TX queue buffer"
	default 1024
	help
	  Maximum size of the HCI RX/TX queue element.

config DTM_HCI_TX_THREAD_STACK_SIZE
	int "Stack size of TX thread"
	default 2048
	help
	  Stack size of the TX thread.

config DTM_HCI_TX_THREAD_PRIORITY
	int "TX thread priority"
	default 7
	help
	  Priority of the TX thread.

endif # DTM_TRANSPORT_HCI

config DTM_POWER_CONTROL_AUTOMATIC
	bool "Automatic power control"
	depends on FEM
	default y
	help
	  Set the SoC output power and the front-end module gain to achieve the TX output power
	  requested by user. If the exact value cannot be achieved, power is set to the closest
	  possible value. If this option is disabled, user can set the SoC output power and the
	  front-end module gain with the separate vendor specific commands.

config DTM_FAST_RAMP_UP
	bool "Enable radio fast ramp up mode"
	default y
	help
	  Do fast ramp up when starting the radio peripheral. This mode will significancy reduce
	  the ramp up time and makes it almost the same on all supported chips.

module = DTM_TRANSPORT
module-str = "DTM_transport"
source "${ZEPHYR_BASE}/subsys/logging/Kconfig.template.log_config"

source "Kconfig.zephyr"
```

## prj.conf
```kconfig
#
# Copyright (c) 2020 Nordic Semiconductor
#
# SPDX-License-Identifier: LicenseRef-Nordic-5-Clause
#

# Configure assertions
CONFIG_ASSERT=y
CONFIG_ASSERT_NO_COND_INFO=y
CONFIG_ASSERT_NO_MSG_INFO=y

CONFIG_HW_STACK_PROTECTION=y

CONFIG_CONSOLE=y
CONFIG_CONSOLE_HANDLER=n
# Enable shell for easy DTM commands via text interface
CONFIG_SHELL=y
CONFIG_SHELL_BACKEND_RTT=y
CONFIG_SHELL_BACKEND_RTT_BUFFER=0
CONFIG_USE_SEGGER_RTT=y
CONFIG_RTT_CONSOLE=y
# RTT buffer configuration
CONFIG_SEGGER_RTT_BUFFER_SIZE_UP=512
CONFIG_SEGGER_RTT_BUFFER_SIZE_DOWN=256
CONFIG_SEGGER_RTT_MAX_NUM_UP_BUFFERS=2
CONFIG_SEGGER_RTT_MAX_NUM_DOWN_BUFFERS=2
CONFIG_UART_CONSOLE=n

# Send logs to RTT channel 1 (Shell uses channel 0)
CONFIG_LOG_BACKEND_RTT=y
CONFIG_LOG_BACKEND_RTT_BUFFER=1
CONFIG_LOG_BACKEND_UART=n

CONFIG_LOG=y
CONFIG_LOG_PRINTK=y

# Use necessary peripherals
CONFIG_NRFX_TIMER0=y
CONFIG_NRFX_TIMER1=y
CONFIG_NRFX_TIMER2=y

CONFIG_FEM_AL_LIB=y

CONFIG_SERIAL=y
# Select RTT two-wire transport for DTM
CONFIG_DTM_TRANSPORT_RTT=y
CONFIG_DTM_TRANSPORT_TWOWIRE=n
CONFIG_DTM_TRANSPORT_HCI=n
```

## src/main.c
```c
/*
 * Copyright (c) 2020 Nordic Semiconductor ASA
 *
 * SPDX-License-Identifier: LicenseRef-Nordic-5-Clause
 */

#include <zephyr/device.h>
#include <zephyr/sys/printk.h>
#include <zephyr/kernel.h>
#include <SEGGER_RTT.h>

#include "transport/dtm_transport.h"
#include "emc_config.h"

/* External function from dtm_cmd_core */
extern uint16_t dtm_cmd_put(uint16_t cmd);

int main(void)
{
	int err;
	uint16_t response;

	err = dtm_tr_init();
	if (err) {
#if !EMC_TEST_MODE
		printk("Error initializing DTM transport: %d\n", err);
#endif
		return err;
	}

#if !EMC_TEST_MODE
	printk("Starting Direct Test Mode with Shell Interface\n");
	printk("DTM Ready - Shell commands available\n");
	printk("Type 'dtm' to see available commands\n");
#endif

#if AUTO_START_TX_MODE
	/* Wait for system to stabilize */
	k_sleep(K_MSEC(100));
	
	/* Reset DTM first */
	response = dtm_cmd_put(0x0000);
#if !EMC_TEST_MODE
	printk("DTM Reset - Response: 0x%04X\n", response);
#endif
	
	k_sleep(K_MSEC(50));
	
	/* Start TX carrier on configured channel
	 * TX command: bits 15-14 = 0x2 (TRANSMITTER_TEST)
	 * Channel is specified in bits 13-8
	 * Length = 0x25 (37 bytes) in bits 7-2 for carrier test
	 * Packet type = 0x0 (PRBS9) in bits 1-0
	 */
	uint16_t tx_cmd = 0x8000 | (AUTO_START_CHANNEL << 8) | (0x25 << 2) | 0x0;
	response = dtm_cmd_put(tx_cmd);
	
#if !EMC_TEST_MODE
	printk("Auto-starting TX carrier on channel %d (%d MHz)\n", 
	       AUTO_START_CHANNEL, 2402 + AUTO_START_CHANNEL * 2);
	printk("TX started - Response: 0x%04X\n", response);
	if ((response & 0x8000) != 0x8000) {
		printk("Warning: Unexpected response from TX command\n");
	}
#endif
#endif

	/* Main loop - minimal activity during EMC testing */
	for (;;) {
#if EMC_TEST_MODE
		/* EMC Test Mode: Minimal CPU activity for clean measurements */
		k_sleep(K_SECONDS(60));  /* Sleep for 1 minute intervals */
#else
		/* Debug Mode: Periodic status updates */
		k_sleep(K_SECONDS(5));
#if AUTO_START_TX_MODE
		static uint32_t counter = 0;
		counter += 5;
		printk("\n[STATUS] TX Test Running - %u seconds elapsed\n", counter);
		printk("         Channel %d (%d MHz) - Transmitting carrier...\n", 
		       AUTO_START_CHANNEL, 2404 + AUTO_START_CHANNEL * 2);
#endif
#endif
	}
}
```

## src/dtm_shell_commands.c
```c
/*
 * DTM Shell Commands for easy testing via RTT
 * Provides text-based commands that translate to DTM 2-byte protocol
 */

#include <zephyr/kernel.h>
#include <zephyr/shell/shell.h>
#include <stdlib.h>
#include "transport/dtm_transport.h"

/* External function from dtm_cmd_core */
extern uint16_t dtm_cmd_put(uint16_t cmd);

static int cmd_dtm_reset(const struct shell *sh, size_t argc, char **argv)
{
	uint16_t response = dtm_cmd_put(0x0000);
	shell_print(sh, "DTM Reset - Response: 0x%04X", response);
	return 0;
}

static int cmd_dtm_rx_test(const struct shell *sh, size_t argc, char **argv)
{
	if (argc != 2) {
		shell_print(sh, "Usage: rx_test <channel>");
		shell_print(sh, "  channel: 0-39 (2404-2482 MHz)");
		return -EINVAL;
	}
	
	uint8_t channel = atoi(argv[1]);
	if (channel > 39) {
		shell_print(sh, "Error: Channel must be 0-39");
		return -EINVAL;
	}
	
	/* RX Test command: bits 15-14 = 0x1 (RECEIVER_TEST)
	 * bits 7-2 = channel, other bits = 0
	 */
	uint16_t cmd = 0x4000 | (channel << 2);  /* 0x4000 = LE_RECEIVER_TEST */
	uint16_t response = dtm_cmd_put(cmd);
	shell_print(sh, "RX Test on channel %d (%.0f MHz) - Response: 0x%04X", 
	            channel, 2404.0 + channel * 2, response);
	return 0;
}

static int cmd_dtm_tx_carrier(const struct shell *sh, size_t argc, char **argv)
{
	if (argc != 2) {
		shell_print(sh, "Usage: tx_carrier <channel>");
		shell_print(sh, "  channel: 0-39 (2404-2482 MHz)");
		return -EINVAL;
	}
	
	uint8_t channel = atoi(argv[1]);
	if (channel > 39) {
		shell_print(sh, "Error: Channel must be 0-39");
		return -EINVAL;
	}
	
	/* TX Test command: bits 15-14 = 0x2 (TRANSMITTER_TEST)
	 * For carrier test, length = 0 (vendor specific for continuous carrier)
	 * bits 13-8 = length (0), bits 7-2 = channel, bits 1-0 = packet type (0)
	 */
	uint16_t cmd = 0x8000 | (channel << 2);  /* 0x8000 = LE_TRANSMITTER_TEST */
	uint16_t response = dtm_cmd_put(cmd);
	shell_print(sh, "TX Carrier on channel %d (%.0f MHz) - Response: 0x%04X", 
	            channel, 2404.0 + channel * 2, response);
	return 0;
}

static int cmd_dtm_tx_test(const struct shell *sh, size_t argc, char **argv)
{
	if (argc != 2 && argc != 3) {
		shell_print(sh, "Usage: tx_test <channel> [length]");
		shell_print(sh, "  channel: 0-39 (2404-2482 MHz)");
		shell_print(sh, "  length: packet length 0-37 (default 37)");
		return -EINVAL;
	}
	
	uint8_t channel = atoi(argv[1]);
	uint8_t length = (argc == 3) ? atoi(argv[2]) : 37;
	
	if (channel > 39) {
		shell_print(sh, "Error: Channel must be 0-39");
		return -EINVAL;
	}
	if (length > 37) {
		shell_print(sh, "Error: Length must be 0-37");
		return -EINVAL;
	}
	
	/* TX Test command: bits 15-14 = 0x2 (TRANSMITTER_TEST)
	 * bits 13-8 = length, bits 7-2 = channel, bits 1-0 = packet type (PRBS9)
	 */
	uint16_t cmd = 0x8000 | (length << 8) | (channel << 2) | 0x00;  /* 0x00 = PRBS9 */
	uint16_t response = dtm_cmd_put(cmd);
	shell_print(sh, "TX Test on channel %d, length %d - Response: 0x%04X", 
	            channel, length, response);
	return 0;
}

static int cmd_dtm_tx_power(const struct shell *sh, size_t argc, char **argv)
{
	if (argc != 2) {
		shell_print(sh, "Usage: tx_power <power_dbm>");
		shell_print(sh, "  power_dbm: TX power in dBm (e.g., 0, 4, 8)");
		return -EINVAL;
	}
	
	int8_t power = atoi(argv[1]);
	
	/* Test Setup command with Set TX Power parameter
	 * bits 15-14 = 0x0 (TEST_SETUP), bits 13-8 = 0x02 (TX_POWER)
	 * bits 7-2 = power level
	 */
	uint16_t cmd = 0x0200 | ((power & 0x3F) << 2);
	uint16_t response = dtm_cmd_put(cmd);
	shell_print(sh, "Set TX Power to %d dBm - Response: 0x%04X", power, response);
	return 0;
}

static int cmd_dtm_end_test(const struct shell *sh, size_t argc, char **argv)
{
	uint16_t response = dtm_cmd_put(0xC000);
	shell_print(sh, "End Test - Response: 0x%04X", response);
	
	/* Extract packet count from response if it's a packet reporting event */
	if (response & 0x8000) {
		uint16_t packet_count = response & 0x7FFF;
		shell_print(sh, "  Packets received: %d", packet_count);
	}
	
	return 0;
}

static int cmd_dtm_raw(const struct shell *sh, size_t argc, char **argv)
{
	if (argc != 2) {
		shell_print(sh, "Usage: dtm_raw <hex_value>");
		shell_print(sh, "  hex_value: 4-digit hex (e.g., 8014 for RX ch 20)");
		return -EINVAL;
	}
	
	uint16_t cmd = strtol(argv[1], NULL, 16);
	uint16_t response = dtm_cmd_put(cmd);
	shell_print(sh, "Sent 0x%04X - Response: 0x%04X", cmd, response);
	return 0;
}

SHELL_STATIC_SUBCMD_SET_CREATE(dtm_cmds,
	SHELL_CMD(reset, NULL, "Reset DTM", cmd_dtm_reset),
	SHELL_CMD(rx_test, NULL, "Start RX test", cmd_dtm_rx_test),
	SHELL_CMD(tx_carrier, NULL, "Start TX carrier (continuous)", cmd_dtm_tx_carrier),
	SHELL_CMD(tx_test, NULL, "Start TX test (modulated)", cmd_dtm_tx_test),
	SHELL_CMD(tx_power, NULL, "Set TX power", cmd_dtm_tx_power),
	SHELL_CMD(end, NULL, "End test", cmd_dtm_end_test),
	SHELL_CMD(raw, NULL, "Send raw DTM command", cmd_dtm_raw),
	SHELL_SUBCMD_SET_END
);

SHELL_CMD_REGISTER(dtm, &dtm_cmds, "DTM test commands", NULL);
```

## src/emc_config.h
```c
/*
 * EMC Test Configuration
 * 
 * This file centralizes EMC test mode configuration to ensure consistency
 * across all source files.
 */

#ifndef EMC_CONFIG_H
#define EMC_CONFIG_H

/* EMC Compliance Test Mode */
#define EMC_TEST_MODE 1          /* Set to 1 for clean EMC testing, 0 for debug mode */

/* Auto-start configuration */
#define AUTO_START_TX_MODE 1
#define AUTO_START_CHANNEL 19    /* Channel 19 = 2440 MHz (2402 + 19*2 = 2440) */

#endif /* EMC_CONFIG_H */
```
